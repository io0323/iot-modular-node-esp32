## firmware/components/node_platform_esp32/Kconfig.projbuild
```kconfig
# 作品02（mcu-cpp-01）の接続の設定（open-questions #102・#103）。
# 値は firmware/sdkconfig.defaults.local（コミットしない）に書き、SDKCONFIG_DEFAULTS で重ねる。
menu "mcu-cpp-01 (portfolio 02)"

    config NODE_WIFI_SSID
        string "Wi-Fi SSID"
        default ""

    config NODE_WIFI_PASSWORD
        string "Wi-Fi password"
        default ""

    config NODE_MQTT_URL
        string "MQTT broker URI (e.g. mqtt://192.168.1.10:1883)"
        default ""

    config NODE_MQTT_PASSWORD
        string "MQTT password (user name is the device_id mcu-cpp-01)"
        default ""

    config NODE_SITE
        string "Topic site (empty means home)"
        default ""

    config NODE_SNTP_SERVER1
        string "1st SNTP server (empty means the MQTT broker host)"
        default ""

    config NODE_SNTP_SERVER2
        string "2nd SNTP server"
        default "pool.ntp.org"

    # ---- 試験用（P7。どれも既定は無効。製品の構成では使わない。open-questions #119・#120・#128）

    config NODE_NET_QEMU_ETH
        bool "TEST: use QEMU OpenCores Ethernet instead of Wi-Fi (emulator only)"
        default n
        select ETH_USE_OPENETH
        help
            QEMU does not emulate Wi-Fi on ESP32-S3. With this option the network is the
            OpenCores Ethernet MAC of QEMU. It does not work on a real chip.

    config NODE_TEST_NO_ADC
        bool "TEST: do not use the ADC (QEMU does not emulate the ESP32-S3 ADC)"
        default n
        help
            The startup self-calibration of esp_adc (adc_hw_calibration, a global constructor)
            waits for the SAR ADC forever in QEMU. With this option the ADC driver is not linked
            and the soil moisture sensor reports a read error (fault).

    config NODE_TEST_FAKE_HW
        bool "TEST: use the fake HAL and devices (same as the host build's --devices fakehw)"
        default n
        help
            Only for the contract tests in QEMU, which emulates neither I2C nor the ADC.
            The drivers run unchanged against fake I2C devices, ADC, PWM and GPIO.

    config NODE_TEST_HANG_TASK
        bool "TEST: stop feeding the task watchdog from the ui task after 10 s"
        default n
        help
            Only for the watchdog test in the emulator. The next BOOT must report watchdog.

    config NODE_WIFI_ALLOW_OPEN
        bool "TEST: allow an open Wi-Fi access point (Wokwi-GUEST)"
        default n
        help
            Only for the Wokwi simulator. The product configuration requires WPA2-PSK or better.

endmenu
```

## firmware/sdkconfig.defaults.local.example
```kconfig
# 見本（#102）。firmware/sdkconfig.defaults.local に写して値を入れる（sdkconfig.defaults.local はコミットしない）。
CONFIG_NODE_WIFI_SSID="your-ssid"
CONFIG_NODE_WIFI_PASSWORD="your-wifi-password"
CONFIG_NODE_MQTT_URL="mqtt://192.168.1.10:1883"
CONFIG_NODE_MQTT_PASSWORD="your-mqtt-password"
CONFIG_NODE_SITE="home"
# 空なら MQTT のブローカーと同じホスト（#103）
CONFIG_NODE_SNTP_SERVER1=""
CONFIG_NODE_SNTP_SERVER2="pool.ntp.org"
```
